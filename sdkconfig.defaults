## sdkconfig.defaults
```kconfig
# Minimal configuration for FIONA HMI (ESP32-P4, JD9165, LVGL9)
CONFIG_IDF_TARGET="esp32p4"
CONFIG_ESPTOOLPY_FLASHMODE_QIO=y
CONFIG_ESPTOOLPY_FLASHSIZE_16MB=y
CONFIG_PARTITION_TABLE_CUSTOM=y
CONFIG_SPIRAM=y
CONFIG_SPIRAM_SPEED_200M=y
CONFIG_SPIRAM_XIP_FROM_PSRAM=y
CONFIG_CACHE_L2_CACHE_256KB=y
CONFIG_CACHE_L2_CACHE_LINE_128B=y
CONFIG_ESP_MAIN_TASK_STACK_SIZE=10240
CONFIG_FREERTOS_HZ=1000

# BSP: LCD Type 1024x600 (JD9165) and RGB565
CONFIG_BSP_LCD_TYPE_1024_600=y
CONFIG_BSP_LCD_COLOR_FORMAT_RGB565=y

# SPIFFS
CONFIG_BSP_SPIFFS_MOUNT_POINT="/spiffs"
CONFIG_BSP_SPIFFS_PARTITION_LABEL="storage"
CONFIG_BSP_SPIFFS_MAX_FILES=10
CONFIG_BSP_SPIFFS_FORMAT_ON_MOUNT_FAIL=y
CONFIG_SPIFFS_GENERATE_BINARY=y

# SD Card
CONFIG_BSP_SD_MOUNT_POINT="/sdcard"
CONFIG_BSP_SD_FORMAT_ON_MOUNT_FAIL=y

# LVGL essential
CONFIG_LV_USE_CLIB_MALLOC=y
CONFIG_LV_USE_CLIB_STRING=y
CONFIG_LV_USE_CLIB_SPRINTF=y
CONFIG_LV_DEF_REFR_PERIOD=15
CONFIG_LV_OS_FREERTOS=y
CONFIG_LV_DRAW_SW_DRAW_UNIT_CNT=2
CONFIG_LV_ATTRIBUTE_FAST_MEM_USE_IRAM=y

# Fonts
CONFIG_LV_FONT_MONTSERRAT_14=y
CONFIG_LV_FONT_MONTSERRAT_20=y
CONFIG_LV_FONT_MONTSERRAT_24=y
CONFIG_LV_FONT_MONTSERRAT_32=y
CONFIG_LV_USE_FONT_COMPRESSED=y

# System monitor
CONFIG_LV_USE_SYSMON=y

# Отключаем всё лишнее
CONFIG_ESP_WIFI_ENABLED=n
CONFIG_BT_ENABLED=n
CONFIG_ESP_ETH_ENABLED=n
CONFIG_LWIP_ENABLED=n
CONFIG_MBEDTLS_ENABLED=n
CONFIG_IEEE802154_ENABLED=n
CONFIG_OPENTHREAD_ENABLED=n
CONFIG_USB_HOST_ENABLED=n
CONFIG_ESP_PHY_ENABLED=n
CONFIG_ESP_COEX_ENABLED=n
CONFIG_WPA_SUPPLICANT_ENABLED=n
```
